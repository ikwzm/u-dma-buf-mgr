## Kconfig
```kconfig
#
# u-dma-buf-mgr
#
config U_DMA_BUF_MGR
	tristate "u-dma-buf-mgr(User space mappable DMA Buffer Manager)"
	depends on U_DMA_BUF
        select U_DMA_BUF_IN_KERNEL_FUNCTIONS
	help
	  u-dma-buf-mbr is device driver for createing and removing u-dma-buf
	  from user space.
	
```
